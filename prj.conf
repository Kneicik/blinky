## prj.conf
```kconfig
CONFIG_SHELL=y
CONFIG_CAN=y
CONFIG_CAN_AUTO_BUS_OFF_RECOVERY=n
CONFIG_CAN_FD_MODE=y
CONFIG_CAN_SHELL=y
```

## src/main.c
```c
/*
 * Copyright (c) 2016 Intel Corporation
 *
 * SPDX-License-Identifier: Apache-2.0
 */

#include <zephyr/kernel.h>

void main(void)
{
	printk("hello world!");
}
```
